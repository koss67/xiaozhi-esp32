## main/boards/bread-compact-wifi/sdkconfig.defaults
```kconfig
CONFIG_ESPTOOLPY_FLASHMODE_DIO=y
CONFIG_SPIRAM_MODE_OCT=y
CONFIG_OLED_SSD1306_128X64=y
CONFIG_BOARD_SUPPORT_RNDIS=n
CONFIG_ESP_AUDIO_ENGINE_ENABLE=n
CONFIG_VOICE_ASSISTANT_WAKE_WORD_DISABLED=y
```
